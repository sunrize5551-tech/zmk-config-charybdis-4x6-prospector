#define INPUT_REL_X 0x00
#define INPUT_REL_Y 0x01

&pro_micro_spi {
    status = "okay";

    cs-gpios = <&gpio0 20 GPIO_ACTIVE_LOW>;

    trackball: trackball@0 {
        status = "okay";
        compatible = "pixart,pmw3610";
        reg = <0>;
        spi-max-frequency = <2000000>;

        /* IMPORTANT: try SPI mode 3 */
        spi-cpol;
        spi-cpha;

        motion-gpios = <&gpio0 6 (GPIO_ACTIVE_LOW | GPIO_PULL_UP)>;

        zephyr,axis-x = <INPUT_REL_X>;
        zephyr,axis-y = <INPUT_REL_Y>;
    };
};
