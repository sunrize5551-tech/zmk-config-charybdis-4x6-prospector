#define INPUT_REL_X 0x00
#define INPUT_REL_Y 0x01

/*
 * Try switching from pro_micro_spi (often SPIM1) to spi0 (often SPIM0).
 * Keep CS/motion pins the same for now.
 */

/ {
    /* This label is referenced by charybdis_right.overlay (&default_transform). */
    default_transform: default_transform {
        compatible = "zmk,kscan-transform";
    };
};

&spi0 {
    status = "okay";

    /* Satisfy Zephyr's pinctrl requirements for nrf-spim */
    pinctrl-0 = <&spi0_default>;
    pinctrl-1 = <&spi0_sleep>;
    pinctrl-names = "default", "sleep";

    cs-gpios = <&gpio0 20 GPIO_ACTIVE_LOW>;

    trackball: trackball@0 {
        status = "okay";
        compatible = "pixart,pmw3610";
        reg = <0>;
        spi-max-frequency = <2000000>;

        /* keep mode 3 test */
        spi-cpol;
        spi-cpha;

        motion-gpios = <&gpio0 6 (GPIO_ACTIVE_LOW | GPIO_PULL_UP)>;

        zephyr,axis-x = <INPUT_REL_X>;
        zephyr,axis-y = <INPUT_REL_Y>;
    };
};
